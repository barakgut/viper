## boards/arm/rookieboard/Kconfig.board
```kconfig
# RookieBoard development board with STM32L071C8 MCU configuration

# Copyright (c) 2020 Barak Gutman <barak381@gmail.com>
# SPDX-License-Identifier: Apache-2.0

config BOARD_ROOKIEBOARD
	bool "RookieBoard STM32L071C8 Development Board"
	depends on SOC_SERIES_STM32L0X
```

## boards/arm/rookieboard/Kconfig.defconfig
```kconfig
# RookieBoard development board with STM32L071C8 MCU configuration

# Copyright (c) 2020 Barak Gutman <barak381@gmail.com>
# SPDX-License-Identifier: Apache-2.0

if BOARD_ROOKIEBOARD

config BOARD
	default "rookieboard"

endif # BOARD_ROOKIEBOARD
```
