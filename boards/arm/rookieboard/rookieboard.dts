/*
 * Copyright (c) 2020 Barak Gutman <barak381@gmail.com>
 *
 * SPDX-License-Identifier: Apache-2.0
 */

/dts-v1/;
#include "stm32l071.dtsi"

/ {
	model = "Barak Gutman RookieBoard STM32L071C8 board";
	compatible = "barakg,rookieboard", "st,stm32l0";

	chosen {
		zephyr,console = &usart1;
		zephyr,shell-uart = &usart1;
	};
};

&usart1 {
	current-speed = <115200>;
	status = "okay";
};
